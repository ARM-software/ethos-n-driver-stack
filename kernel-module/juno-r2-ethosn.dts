/ {
	reserved-memory {
		#address-cells = <2>;
		#size-cells = <2>;
		ranges;

		/* 'ethosn_reserved' must be page aligned (page size = 0x1000) */
		ethosn_reserved: ethosn_reserved@a0000000 {
			compatible = "shared-dma-pool";
			reg = <0 0xa0000000 0 0x20000000>;
			no-map;
		};
	};

	ethosn@60000000 {
		compatible = "ethosn";
		reg = <0 0x6f300000 0 0x00100000>;
		reg-names = "top_regs";
		memory-region = <&ethosn_reserved>;
		/* The Juno FPGA integration combines all of the Ethos-N's interrupts
		 * into a single level-sensitive interrupt line. */
		interrupts = <0 168 4>, <0 168 4>, <0 168 4>;
		interrupt-names = "err", "job", "debug";
	};
};
